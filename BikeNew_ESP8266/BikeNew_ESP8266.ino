
#include <ESP8266WiFiMulti.h>
#include <NTPClient.h>
#include <WiFiUdp.h>
#include <Wire.h>
#include <SFE_BMP180.h>

SFE_BMP180 bmp180;
float alt = 155.0; // Altitude of current location in meters
float Po = 1015.0;
#include <Adafruit_GFX.h>
#include <Adafruit_SSD1305.h> //OLED display library
#include <Fonts/FreeMono9pt7b.h>
#include <Fonts/FreeSans18pt7b.h>

#include <RTClib.h>

#include <EEPROM.h> //This library allows reading and writing to the EEPROM
#define OLED_RESET -1


const char *ssid2 = "1"; // your wifi name
const char *pw2   = "1";// your wifi password

const char *ssid1 = "1"; // your wifi name
const char *pw1   = "1";// your wifi password

const char *ssid3 = "1"; // your wifi name
const char *pw3   = "1";// your wifi password

const char *ssid4 = "PHONE"; // your wifi name
const char *pw4   = "12345678";// your wifi password

const long timezoneOffset = 1 * 60 * 60; // ? hours * 60 * 60

//ESP32Time rtc(0);
RTC_DS3231 rtc;
char t[32];

const char          *ntpServer  = "uk.pool.ntp.org"; // change it to local NTP server if needed
const unsigned long updateDelay = 900000;         // update time every 15 min
const unsigned long retryDelay  = 5000;           // retry 5 sec later if time query failed
const String        weekDays[7] = {"Sun", "Mon", "Tue", "Wed", "Thu", "Fri", "Sat"};

unsigned long lastUpdatedTime = updateDelay * -1;
unsigned int  second_prev = 0;
bool          colon_switch = false;
bool          wifiConnected = false;
bool          timeSet;

ESP8266WiFiMulti WiFiMulti;
WiFiUDP ntpUDP;
NTPClient timeClient(ntpUDP, ntpServer);
Adafruit_SSD1305 display(128, 32, &Wire, OLED_RESET);


#define HONDA_2_HEIGHT 32
#define HONDA_2_WIDTH 128
 
const unsigned char Honda_2_bmp [] PROGMEM = {
//static const unsigned char Honda_2_bmp[] u8x8_PROGMEM= {
0x00, 0x00, 0x00, 0x00, 0x00, 0x00, 0x00, 0x00, 0x00, 0x00, 0x00, 0x00, 0x00, 0x00, 0x00, 0x00,
0x00, 0x00, 0x00, 0x00, 0x00, 0x00, 0x00, 0x00, 0x00, 0x00, 0x00, 0x00, 0x00, 0x00, 0x00, 0x00,
0x00, 0x00, 0x00, 0x00, 0x00, 0x00, 0x00, 0x00, 0x00, 0x00, 0x00, 0x00, 0x00, 0x00, 0x00, 0x00,
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0x00, 0x00, 0x00, 0x00, 0x00, 0x00, 0x00, 0x00, 0x00, 0x00, 0x00, 0x00, 0x00, 0x00, 0x00, 0x00
}; 
#define SCREEN_WIDTH 128 // OLED display width, in pixels
#define SCREEN_HEIGHT 32 // OLED display height, in pixels
 
// ------------------- For i2c -------------------
//// Declaration for an SSD1306 display connected to I2C (SDA, SCL pins)
#define OLED_RESET     -1 // Reset pin # (or -1 if sharing Arduino reset pin)
  

void setup() {

  // init done

  Serial.begin(9600);
  //Draw splash screeN
  yield();
  display.begin(0x3C);
  yield();
  display.clearDisplay();

 
  display.drawBitmap(0,1, Honda_2_bmp, HONDA_2_WIDTH, HONDA_2_HEIGHT, 1);
  display.display();
  delay(5000);

  drawTxtToDisplay(" Connecting --to Wifi--");

  //Wire.begin();
  rtc.begin();
  bool success = bmp180.begin();

  if (success) {
    Serial.println("BMP180 init success");
  }


  
  WiFiMulti.addAP(ssid1, pw1); // multiple ssid/pw can be added
  WiFiMulti.addAP(ssid2, pw2); // multiple ssid/pw can be added
  WiFiMulti.addAP(ssid3, pw3); // multiple ssid/pw can be added
  WiFiMulti.addAP(ssid4, pw4); // multiple ssid/pw can be added  

  for (int i = 0; i < 2; i++){
    if (WiFiMulti.run() == WL_CONNECTED) {
      wifiConnected = true;
      drawTxtToDisplay("...Wifi....  ..connected.");
      delay(1500);

      drawTxtToDisplay("..Updating......RTC....");
      delay(2000);

      break;
    }
    if (WiFiMulti.run() != WL_CONNECTED) {
      delay(200);
      Serial.print(".");
    }
  }
  
  if (wifiConnected == true) {
    Serial.println("\nConnected.");
    timeClient.setTimeOffset(timezoneOffset);
    timeClient.begin();
    timeClient.update();
    timeSet = true;

  }else{
    drawTxtToDisplay("Connection  failed");
    delay(2000);
     
    drawTxtToDisplay("HOTSPOT =    PHONE");
      delay(5000);
      
     drawTxtToDisplay("PASSWORD=  12345678");
      delay(5000); 

    timeSet = false;
  }
}

void loop() { 
  
  char status;
  double T, P, alt,seaLevelPressure;
  bool success = false;

  status = bmp180.startTemperature();
  if (status != 0) {
    status = bmp180.getTemperature(T);
    if (status != 0) {
      status = bmp180.startPressure(3);
      if (status != 0) {
        status = bmp180.getPressure(P, T);
        if (status != 0) {
          seaLevelPressure = bmp180.sealevel(P, alt);
        }
      }
    }
  }



  
  if (wifiConnected == true){

    time_t rawtime = timeClient.getEpochTime();
    struct tm * ti;

    ti = localtime (&rawtime);
    unsigned int year = ti->tm_year + 1900;

    ti = localtime (&rawtime);
    unsigned int month = ti->tm_mon + 1;

    ti = localtime (&rawtime);
    unsigned int day = ti->tm_mday;

    unsigned int hour = timeClient.getHours();
    unsigned int minute = timeClient.getMinutes();
    unsigned int seconds = timeClient.getSeconds();

    rtc.adjust(DateTime(year, month, day, hour, minute, seconds));
    wifiConnected = false;  
    timeClient.end(); 
  }
  
  DateTime now = rtc.now();
 
  sprintf(t, "%02d:%02d:%02d %02d/%02d/%02d",  now.hour(), now.minute(), now.second(), now.day(), now.month(), now.year());  

  unsigned long t = millis();
  int second = now.second();
  if (second != second_prev) colon_switch = !colon_switch;

  String fTime = (now.hour() < 10 ? "0" : "") + String(now.hour()) + (colon_switch ? ":" : " ") + (now.minute() < 10 ? "0" : "") + String(now.minute());

  //gets the time ready to dsiplay
  drawTimeToDisplay(fTime);

  // draws hor & ver lines for seperation of other values
  display.drawFastVLine(93,0,32,1);
  display.drawFastHLine(93,15,37,1);
  display.drawRect(0,0,128,32, 1);
 

  second_prev = second;

  int diff = millis() - t;
  delay(diff >= 0 ? (500 - (millis() - t)) : 0);

  //only display done during loop, prevents flashing of ui
  display.display();
}

void drawTxtToDisplay(String txt){
  //21 char per line
  display.setFont(&FreeMono9pt7b);
  display.clearDisplay();
  display.setTextSize(1);
  display.setTextWrap(true);
  display.setTextColor(WHITE);
  display.setCursor(1,13);
  display.print(txt);
  display.display();
}
void drawTimeToDisplay(String txt){
  display.setFont(&FreeSans18pt7b);
  display.clearDisplay();
  display.setTextSize(1);
  display.setTextWrap(true);
  display.setTextColor(WHITE);
  display.setCursor(3,28);
  display.print(txt);
}
